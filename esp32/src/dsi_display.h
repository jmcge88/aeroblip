#pragma once
#include "pin_config.h"

#ifdef PANEL_DSI
#include <Arduino_GFX_Library.h>
#include <esp_cache.h>
#include <esp_ldo_regulator.h>

// ESP32-P4-WIFI6-Touch-LCD-4B: 720x720 ST7703 over 2-lane MIPI-DSI.
//
// The UI draws into the usual 480x480 Arduino_Canvas (PSRAM); dsiPresent()
// scales that frame 1.5x into the DPI framebuffer: every 2x2 source block
// becomes 3x3, the middle row/column the average of its neighbours. Plain
// nearest-neighbour would make every other 1-px stroke 2 px wide; the blend
// keeps text weight even at the cost of slightly soft edges.

// Timings and init sequence: Waveshare esp_lcd_st7703 2.0.0
// (ST7703_720_720_PANEL_60HZ_DPI_CONFIG + vendor_specific_init_default)
#define DSI_LANE_MBPS 480
#define DSI_DPI_CLOCK_HZ 38000000
#define DSI_HSYNC_PW 20
#define DSI_HSYNC_BP 50
#define DSI_HSYNC_FP 50
#define DSI_VSYNC_PW 4
#define DSI_VSYNC_BP 20
#define DSI_VSYNC_FP 20

static const lcd_init_cmd_t st7703_init_operations[] = {
    {0xB9, (uint8_t[]){0xF1, 0x12, 0x83}, 3, 0},
    {0xB1, (uint8_t[]){0x00, 0x00, 0x00, 0xDA, 0x80}, 5, 0},
    {0xB2, (uint8_t[]){0x3C, 0x12, 0x30}, 3, 0},
    {0xB3, (uint8_t[]){0x10, 0x10, 0x28, 0x28, 0x03, 0xFF, 0x00, 0x00, 0x00, 0x00}, 10, 0},
    {0xB4, (uint8_t[]){0x80}, 1, 0},
    {0xB5, (uint8_t[]){0x0A, 0x0A}, 2, 0},
    {0xB6, (uint8_t[]){0x97, 0x97}, 2, 0},
    {0xB8, (uint8_t[]){0x26, 0x22, 0xF0, 0x13}, 4, 0},
    {0xBA, (uint8_t[]){0x31, 0x81, 0x0F, 0xF9, 0x0E, 0x06, 0x20, 0x00, 0x00, 0x00, 0x00, 0x00,
                       0x00, 0x00, 0x44, 0x25, 0x00, 0x90, 0x0A, 0x00, 0x00, 0x01, 0x4F, 0x01,
                       0x00, 0x00, 0x37},
     27, 0},
    {0xBC, (uint8_t[]){0x47}, 1, 0},
    {0xBF, (uint8_t[]){0x02, 0x11, 0x00}, 3, 0},
    {0xC0, (uint8_t[]){0x73, 0x73, 0x50, 0x50, 0x00, 0x00, 0x12, 0x70, 0x00}, 9, 0},
    {0xC1, (uint8_t[]){0x25, 0x00, 0x32, 0x32, 0x77, 0xE4, 0xFF, 0xFF, 0xCC, 0xCC, 0x77, 0x77}, 12, 0},
    {0xC6, (uint8_t[]){0x82, 0x00, 0xBF, 0xFF, 0x00, 0xFF}, 6, 0},
    {0xC7, (uint8_t[]){0xB8, 0x00, 0x0A, 0x10, 0x01, 0x09}, 6, 0},
    {0xC8, (uint8_t[]){0x10, 0x40, 0x1E, 0x02}, 4, 0},
    {0xCC, (uint8_t[]){0x0B}, 1, 0},
    {0xE0, (uint8_t[]){0x00, 0x0B, 0x10, 0x2C, 0x3D, 0x3F, 0x42, 0x3A, 0x07, 0x0D, 0x0F, 0x13,
                       0x15, 0x13, 0x14, 0x0F, 0x16, 0x00, 0x0B, 0x10, 0x2C, 0x3D, 0x3F, 0x42,
                       0x3A, 0x07, 0x0D, 0x0F, 0x13, 0x15, 0x13, 0x14, 0x0F, 0x16},
     34, 0},
    {0xE3, (uint8_t[]){0x07, 0x07, 0x0B, 0x0B, 0x0B, 0x0B, 0x00, 0x00, 0x00, 0x00, 0xFF, 0x00,
                       0xC0, 0x10},
     14, 0},
    {0xE9, (uint8_t[]){0xC8, 0x10, 0x0A, 0x00, 0x00, 0x80, 0x81, 0x12, 0x31, 0x23, 0x4F, 0x86,
                       0xA0, 0x00, 0x47, 0x08, 0x00, 0x00, 0x0C, 0x00, 0x00, 0x00, 0x00, 0x00,
                       0x0C, 0x00, 0x00, 0x00, 0x98, 0x02, 0x8B, 0xAF, 0x46, 0x02, 0x88, 0x88,
                       0x88, 0x88, 0x88, 0x98, 0x13, 0x8B, 0xAF, 0x57, 0x13, 0x88, 0x88, 0x88,
                       0x88, 0x88, 0x00, 0x00, 0x00, 0x00, 0x00, 0x00, 0x00, 0x00, 0x00, 0x00,
                       0x00, 0x00, 0x00},
     63, 0},
    {0xEA, (uint8_t[]){0x97, 0x0C, 0x09, 0x09, 0x09, 0x78, 0x00, 0x00, 0x00, 0x00, 0x00, 0x00,
                       0x9F, 0x31, 0x8B, 0xA8, 0x31, 0x75, 0x88, 0x88, 0x88, 0x88, 0x88, 0x9F,
                       0x20, 0x8B, 0xA8, 0x20, 0x64, 0x88, 0x88, 0x88, 0x88, 0x88, 0x23, 0x00,
                       0x00, 0x02, 0x71, 0x00, 0x00, 0x00, 0x00, 0x00, 0x00, 0x00, 0x00, 0x00,
                       0x00, 0x00, 0x00, 0x00, 0x00, 0x00, 0x40, 0x80, 0x81, 0x00, 0x00, 0x00,
                       0x00},
     61, 0},
    {0xEF, (uint8_t[]){0xFF, 0xFF, 0x01}, 3, 0},
    {0x11, (uint8_t[]){0x00}, 1, 250},
    {0x29, (uint8_t[]){0x00}, 1, 50},
};

// Board rails the vendor BSP raises before the panel: LDO3 2.5 V feeds the
// DSI PHY (Arduino_ESP32DSIPanel acquires that one itself), LDO4 3.3 V the
// panel/SD side. Must run before canvas->begin().
static inline void dsiPowerOn() {
  static esp_ldo_channel_handle_t vo4 = nullptr;
  if (vo4) return;
  esp_ldo_channel_config_t cfg = {};
  cfg.chan_id = 4;
  cfg.voltage_mv = 3300;
  if (esp_ldo_acquire_channel(&cfg, &vo4) != ESP_OK) Serial.println("[dsi] LDO4 acquire failed");
}

// Backlight: 10-bit LEDC on LCD_BL, active low. level is the AMOLED-era
// 0-255 brightness the rest of the firmware speaks.
static inline void dsiBacklight(int level) {
  static bool attached = false;
  if (!attached) attached = ledcAttach(LCD_BL, 5000, 10);
  if (level < 0) level = 0;
  if (level > 255) level = 255;
  ledcWrite(LCD_BL, 1023 - (uint32_t)level * 1023 / 255);
}

static inline uint16_t mix565(uint16_t a, uint16_t b) {
  return ((a & 0xF7DE) >> 1) + ((b & 0xF7DE) >> 1) + (a & b & 0x0821);
}

static inline void upscaleRow(const uint16_t *s, uint16_t *d, int sw) {
  for (int x = 0; x < sw; x += 2) {
    uint16_t a = s[x], b = s[x + 1];
    d[0] = a;
    d[1] = mix565(a, b);
    d[2] = b;
    d += 3;
  }
}

// src: sw x sh (both even), dst: (sw*3/2) x (sh*3/2)
static inline void upscale3over2(const uint16_t *src, int sw, int sh, uint16_t *dst) {
  const int dw = sw * 3 / 2;
  for (int y = 0; y < sh; y += 2) {
    uint16_t *r0 = dst, *r1 = dst + dw, *r2 = dst + 2 * dw;
    upscaleRow(src + y * sw, r0, sw);
    upscaleRow(src + (y + 1) * sw, r2, sw);
    for (int x = 0; x < dw; x++) r1[x] = mix565(r0[x], r2[x]);
    dst += 3 * dw;
  }
}

// Push a finished logical frame to the panel
static inline void dsiPresent(Arduino_Canvas *canvas, Arduino_DSI_Display *panel) {
  uint16_t *fb = panel->getFramebuffer();
  if (!fb) return;
  upscale3over2(canvas->getFramebuffer(), LCD_WIDTH, LCD_HEIGHT, fb);
  esp_cache_msync(fb, (size_t)PANEL_W * PANEL_H * 2, ESP_CACHE_MSYNC_FLAG_DIR_C2M);
}
#endif
